// SPDX-License-Identifier: (GPL-2.0+ OR MIT)
/*
 * Device Tree Include file for Marvell Armada 372x family of SoCs
 * (also named 88F3720)
 *
 * Copyright (C) 2016 Marvell
 *
 * Gregory CLEMENT <gregory.clement@free-electrons.com>
 *
 */

#include "armada-37xx.dtsi"

/ {
	model = "Marvell Armada 3720 SoC";
	compatible = "marvell,armada3720", "marvell,armada3710";

	cpus {
		cpu1: cpu@1 {
			device_type = "cpu";
			compatible = "arm,cortex-a53";
			reg = <0x1>;
			clocks = <&nb_periph_clk 16>;
			enable-method = "psci";
                        /* https://datasheet.datasheetarchive.com/originals/crawler/marvell.com/18bd41681c6d1d9932acc66ac0482950.pdf */
                        /* https://developer.arm.com/documentation/ddi0500/e/level-1-memory-system/about-the-l1-memory-system */
                        d-cache-size = <0x8000>;   // 32KB 4-way set-associative data cache
                        d-cache-line-size = <64>;  // Fixed line length of 64 bytes
                        d-cache-sets = <128>;      // 32KiB(size)/64(line-size)=512ways/4-way set
                        i-cache-size = <0x8000>;   // 32kB 2-way set-associative data cache
                        i-cache-line-size = <64>;  // Fixed line length of 64 bytes
                        i-cache-sets = <256>;      // 32KiB(size)/64(line-size)=512ways/2-way set
                        next-level-cache = <&l2>;
		};
	};
};
